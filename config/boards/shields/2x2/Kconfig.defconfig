## config/boards/shields/2x2/Kconfig.defconfig
```kconfig
if SHIELD_2x2_LEFT
config ZMK_KEYBOARD_NAME
    default "2x2x2_split"
config ZMK_SPLIT_ROLE_CENTRAL
   default y
endif

if SHIELD_2x2_LEFT || SHIELD_2x2_RIGHT
config ZMK_SPLIT
    default y
endif
```

## config/boards/shields/2x2/Kconfig.shield
```kconfig
config SHIELD_2x2_LEFT
    def_bool $(shields_list_contains,2x2_left)

config SHIELD_2x2_RIGHT
    def_bool $(shields_list_contains,2x2_right)
```
